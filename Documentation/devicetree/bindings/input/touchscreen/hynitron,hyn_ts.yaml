## Documentation/devicetree/bindings/input/touchscreen/hynitron,hyn_ts.yaml
```yaml
# SPDX-License-Identifier: (GPL-2.0-only OR BSD-2-Clause)
%YAML 1.2
---
$id: http://devicetree.org/schemas/input/touchscreen/hynitron,hyn_ts.yaml#
$schema: http://devicetree.org/meta-schemas/core.yaml#

title: Hynitron CST3xx, CST3240 and CST7xx I2C touch controllers

maintainers:
  - Honsun Zhu <honsun@linux.com>

description: |
  Hynitron mutual capacitance (CST3xx, CST3240) and self capacitance
  (CST7xx) touch controllers.  They are found on the optional MIPI touch
  panels of boards such as the Sipeed LicheeRV Nano, where the fitted panel
  decides which of the families is present:

    - "hyn,3xx":  CST340, CST348 and compatible parts, at I2C address 0x1a
    - "hyn,3240": CST3240, at I2C address 0x5a
    - "hyn,7xx":  CST716, CST726, CST736 and compatible parts, at 0x15

  The compatible string selects the register protocol, so the family string
  is mandatory.  "hynitron,hyn_ts" is the generic name used by the Hynitron
  vendor driver and, when present, must be followed by the family string.

properties:
  compatible:
    oneOf:
      - enum:
          - hyn,3xx
          - hyn,3240
          - hyn,7xx
      - items:
          - const: hynitron,hyn_ts
          - enum:
              - hyn,3xx
              - hyn,3240
              - hyn,7xx

  reg:
    maxItems: 1
    description: I2C address of the controller in application mode.

  interrupts:
    maxItems: 1

  reset-gpios:
    maxItems: 1
    description: Active low reset line, deasserted while the controller runs.

required:
  - compatible
  - reg
  - interrupts
  - reset-gpios

allOf:
  - $ref: touchscreen.yaml#

unevaluatedProperties: false

examples:
  - |
    #include <dt-bindings/gpio/gpio.h>
    #include <dt-bindings/interrupt-controller/irq.h>

    i2c {
        #address-cells = <1>;
        #size-cells = <0>;

        touchscreen@15 {
            compatible = "hyn,7xx";
            reg = <0x15>;
            interrupt-parent = <&gpio4>;
            interrupts = <3 IRQ_TYPE_EDGE_FALLING>;
            reset-gpios = <&gpio4 4 GPIO_ACTIVE_LOW>;
            touchscreen-size-x = <368>;
            touchscreen-size-y = <552>;
        };
    };

  - |
    #include <dt-bindings/gpio/gpio.h>
    #include <dt-bindings/interrupt-controller/irq.h>

    i2c {
        #address-cells = <1>;
        #size-cells = <0>;

        touchscreen@5a {
            compatible = "hynitron,hyn_ts", "hyn,3240";
            reg = <0x5a>;
            interrupt-parent = <&gpio4>;
            interrupts = <3 IRQ_TYPE_EDGE_FALLING>;
            reset-gpios = <&gpio4 4 GPIO_ACTIVE_LOW>;
            touchscreen-size-x = <480>;
            touchscreen-size-y = <640>;
        };
    };

...
```

## Documentation/devicetree/bindings/power/reset/cvitek,restart.yaml
```yaml
# SPDX-License-Identifier: (GPL-2.0-only OR BSD-2-Clause)
%YAML 1.2
---
$id: http://devicetree.org/schemas/power/reset/cvitek,restart.yaml#
$schema: http://devicetree.org/meta-schemas/core.yaml#

title: Cvitek/Sophgo CV18xx restart and power-off

maintainers:
  - Djair Guilherme <djair.jr@gmail.com>

description: |
  Warm reset and shutdown of the CV180x/CV181x/SG200x SoCs through the RTC
  control block. The block overlaps the mainline RTC node (which describes it
  as a syscon), so this node only needs the register window.

properties:
  compatible:
    const: cvitek,restart

  reg:
    maxItems: 1

required:
  - compatible
  - reg

additionalProperties: false

examples:
  - |
    restart@5025000 {
        compatible = "cvitek,restart";
        reg = <0x05025000 0x2000>;
    };
```

## Documentation/devicetree/bindings/pwm/sophgo,cv1800-pwm.yaml
```yaml
# SPDX-License-Identifier: (GPL-2.0-only OR BSD-2-Clause)
%YAML 1.2
---
$id: http://devicetree.org/schemas/pwm/sophgo,cv1800-pwm.yaml#
$schema: http://devicetree.org/meta-schemas/core.yaml#

title: Sophgo CV18xx / SG200x PWM controller

maintainers:
  - Djair Guilherme da Silva Junior <djair.jr@gmail.com>

description: |
  Four PWM controllers, four channels each. Every controller has its own
  register window and 16-bit period/duty counters clocked by the PWM clock.
  The channel numbering is global: channel n of the controller at
  0x3060000 + n * 0x1000 drives PWM_<4 * n .. 4 * n + 3>.

allOf:
  - $ref: pwm.yaml#

properties:
  compatible:
    const: sophgo,cv1800-pwm

  reg:
    maxItems: 1

  clocks:
    maxItems: 1

  clock-names:
    const: pwm

required:
  - compatible
  - reg
  - clocks

unevaluatedProperties: false

examples:
  - |
    #include <dt-bindings/clock/sophgo,cv1800.h>

    pwm@3062000 {
        compatible = "sophgo,cv1800-pwm";
        reg = <0x03062000 0x1000>;
        clocks = <&clk CLK_PWM>;
        #pwm-cells = <3>;
    };
```

## Documentation/devicetree/bindings/sound/sophgo,cv1800b-codecs.yaml
```yaml
# SPDX-License-Identifier: (GPL-2.0-only OR BSD-2-Clause)
%YAML 1.2
---
$id: http://devicetree.org/schemas/sound/sophgo,cv1800b-codecs.yaml#
$schema: http://devicetree.org/meta-schemas/core.yaml#

title: Sophgo CV1800B Internal ADC/DAC Codec

maintainers:
  - Anton D. Stavinskii <stavinsky@gmail.com>

description:
  Internal ADC and DAC audio codecs integrated in the Sophgo CV1800B SoC.
  Codecs expose a single DAI and are intended to be connected
  to an I2S/TDM controller via an ASoC machine driver.

allOf:
  - $ref: dai-common.yaml#

properties:
  compatible:
    enum:
      - sophgo,cv1800b-sound-adc
      - sophgo,cv1800b-sound-dac

  reg:
    maxItems: 1

  "#sound-dai-cells":
    const: 0

  clocks:
    maxItems: 1

  clock-names:
    const: mclk

  sophgo,mclk-source:
    $ref: /schemas/types.yaml#/definitions/phandle
    description: |
      Phandle of the I2S/TDM controller whose MCLK output clocks this codec.
      The internal ADC has no clock of its own: it takes the MCLK output of
      another I2S block (I2S3 on the SG2002). When present, the driver turns
      that output on and programs MCLK = 256 fs before capturing.

required:
  - compatible
  - reg
  - "#sound-dai-cells"

unevaluatedProperties: false

examples:
  - |
    audio-codec@300a100 {
      compatible = "sophgo,cv1800b-sound-adc";
      reg = <0x0300a100 0x100>;
      #sound-dai-cells = <0>;
    };
...
```

## Documentation/devicetree/bindings/thermal/cvitek,cv181x-thermal.yaml
```yaml
# SPDX-License-Identifier: (GPL-2.0-only OR BSD-2-Clause)
%YAML 1.2
---
$id: http://devicetree.org/schemas/thermal/cvitek,cv181x-thermal.yaml#
$schema: http://devicetree.org/meta-schemas/core.yaml#

title: Cvitek/Sophgo CV181x (SG200x) temperature sensor

maintainers:
  - Djair Guilherme <djair.jr@gmail.com>

description: |
  The on-die temperature sensor of the CV181x family (SG2000/SG2002). It has
  one sensor and one high/low interrupt.

allOf:
  - $ref: thermal-sensor.yaml#

properties:
  compatible:
    const: cvitek,cv181x-thermal

  reg:
    maxItems: 1

  clocks:
    maxItems: 1

  clock-names:
    const: clk_tempsen

  interrupts:
    maxItems: 1

  reset-names:
    const: tempsen

  resets:
    maxItems: 1

required:
  - compatible
  - reg
  - clocks
  - clock-names
  - "#thermal-sensor-cells"

unevaluatedProperties: false

examples:
  - |
    #include <dt-bindings/clock/sophgo,cv1800.h>
    #include <dt-bindings/interrupt-controller/irq.h>

    thermal-sensor@30e0000 {
        compatible = "cvitek,cv181x-thermal";
        reg = <0x030e0000 0x10000>;
        interrupts = <16 IRQ_TYPE_LEVEL_HIGH>;
        interrupt-names = "tempsen";
        clocks = <&clk CLK_TEMPSEN>;
        clock-names = "clk_tempsen";
        #thermal-sensor-cells = <1>;
    };
```

## Documentation/devicetree/bindings/ufs/allwinner,sun60i-a733-ufs.yaml
```yaml
# SPDX-License-Identifier: (GPL-2.0-only OR BSD-2-Clause)
%YAML 1.2
---
$id: http://devicetree.org/schemas/ufs/allwinner,sun60i-a733-ufs.yaml#
$schema: http://devicetree.org/meta-schemas/core.yaml#

title: Allwinner A733 Universal Flash Storage Host Controller

maintainers:
  - Hansun Zhu <honsun@linux.com>

allOf:
  - $ref: ufs-common.yaml

properties:
  compatible:
    const: allwinner,sun60i-a733-ufs

  reg:
    maxItems: 1

  clocks:
    maxItems: 11

  clock-names:
    items:
      - const: osc24m
      - const: pll_periph
      - const: pll_periph_2
      - const: axi_clk_gate
      - const: ahb_gate
      - const: cfg_clk_gate
      - const: store_ahb
      - const: store_mbus
      - const: msi_lite
      - const: dcxo_wakeup
      - const: dcxo_ufs_gating

  resets:
    maxItems: 4

  reset-names:
    items:
      - const: controller_rst
      - const: phy_rst
      - const: axi_rst
      - const: ahb_rst

  nvmem-cells:
    minItems: 2
    maxItems: 2

  nvmem-cell-names:
    items:
      - const: calibration-low
      - const: calibration-high

  vcc-supply: true
  vccq-supply: true
  vccq2-supply: true

required:
  - compatible
  - reg
  - clocks
  - clock-names
  - resets
  - reset-names
  - nvmem-cells
  - nvmem-cell-names
  - vcc-supply
  - vccq-supply
  - vccq2-supply

dependencies:
  nvmem-cells: [nvmem-cell-names]

unevaluatedProperties: false
```

## bsp/drivers/net/wireless/Kconfig
```kconfig
menu "Wireless LAN"
	depends on !S390
	depends on NET

if WLAN

# AIC8800 is shared by Allwinner, Rockchip and RISC-V boards, so it stays
# selectable when AW_BSP is disabled.
source "$(BSP_TOP)drivers/net/wireless/aic8800/Kconfig"

if AW_BSP
source "$(BSP_TOP)drivers/net/wireless/bcmdhd/Kconfig"
source "$(BSP_TOP)drivers/net/wireless/rtl8188fu/Kconfig"
source "$(BSP_TOP)drivers/net/wireless/rtl8723cs/Kconfig"
source "$(BSP_TOP)drivers/net/wireless/rtl8723ds/Kconfig"
source "$(BSP_TOP)drivers/net/wireless/rtl8723du/Kconfig"
source "$(BSP_TOP)drivers/net/wireless/rtl8822bs/Kconfig"
source "$(BSP_TOP)drivers/net/wireless/rtl8822cu/Kconfig"
source "$(BSP_TOP)drivers/net/wireless/rtl8852bs/Kconfig"
source "$(BSP_TOP)drivers/net/wireless/xr819/Kconfig"
source "$(BSP_TOP)drivers/net/wireless/xr829/Kconfig"
source "$(BSP_TOP)drivers/net/wireless/uwe5622/Kconfig"
source "$(BSP_TOP)drivers/net/wireless/atbm6023is/Kconfig"
source "$(BSP_TOP)drivers/net/wireless/ssv6158/Kconfig"
endif

endif

endmenu
```

## bsp/drivers/net/wireless/aic8800/Kconfig
```kconfig
config AIC_WLAN_SUPPORT
	tristate "AIC wireless Support"
	depends on CFG80211
	depends on MMC || USB
	help
	  Support for AIC8800/AIC8801 wireless chips.  This single driver
	  tree is shared between the Allwinner BSP, Rockchip boards and
	  RISC-V boards; it does not require CONFIG_AW_BSP.

	  The BSP part of the driver loads the firmware with
	  request_firmware() from these paths below /lib/firmware:

	    aic8800d80/fw_adid_8800d80_u02.bin
	    aic8800d80/fw_patch_8800d80_u02.bin
	    aic8800d80/fw_patch_table_8800d80_u02.bin
	    aic8800d80/fmacfw_8800d80_u02.bin
	    aic8800dc/... (AIC8800DC/DW variants)

	  The firmware is a vendor binary and is not part of this source
	  tree.  Distributions that install the files as
	  /lib/firmware/aic8800_fw/SDIO/aic8800D80/ can provide a symlink
	  /lib/firmware/aic8800d80 -> aic8800_fw/SDIO/aic8800D80.

choice
	prompt "Enable Chip Interface"
	depends on AIC_WLAN_SUPPORT
	help
		Enable Chip Interface.
config AIC_INTF_SDIO
		bool "SDIO interface support"
		depends on MMC && (MMC = y || AIC_WLAN_SUPPORT = m)
config AIC_INTF_USB
		bool "USB interface support"
		depends on USB && (USB = y || AIC_WLAN_SUPPORT = m)
endchoice

choice
	prompt "Choice host wake IRQ type"
	depends on AIC_WLAN_SUPPORT
	default AIC_IRQ_ACTIVE_UNSET
	help
		Choice host wake IRQ type.
config AIC_IRQ_ACTIVE_UNSET
		bool "UNSET IRQ type use default config"
config AIC_IRQ_ACTIVE_HIGH
		bool "host wake High level trigger"
config AIC_IRQ_ACTIVE_RISING
		bool "host wake RISING trigger"
config AIC_IRQ_ACTIVE_LOW
		bool "host wake Low level trigger"
config AIC_IRQ_ACTIVE_FALLING
		bool "host wake FALLING trigger"
endchoice

config USB_MSG_EP
	bool "Enable usb message endpoint"
	default y if AIC_INTF_USB
	depends on AIC_INTF_USB
	help
	  This would enable usb message endpoint

if AIC_WLAN_SUPPORT
source "$(BSP_TOP)drivers/net/wireless/aic8800/aic8800_fdrv/Kconfig"
source "$(BSP_TOP)drivers/net/wireless/aic8800/aic8800_btlpm/Kconfig"
endif

if AIC_INTF_USB
source "$(BSP_TOP)drivers/net/wireless/aic8800/aic8800_btusb/Kconfig"
endif
```

## bsp/drivers/net/wireless/aic8800/aic8800_btlpm/Kconfig
```kconfig
config AIC8800_BTLPM_SUPPORT
	tristate "AIC8800 bluetooth Support (UART)"
	depends on BT && GPIOLIB
	help
	  This is support for aic uart bluetooh driver.
```

## bsp/drivers/net/wireless/aic8800/aic8800_btusb/Kconfig
```kconfig
config AIC8800_BTUSB_SUPPORT
	tristate "AIC8800 bluetooth Support (USB)"
	depends on AIC_WLAN_SUPPORT && BT && USB
	help
	  This is support for aic usb bluetooh driver.
```

## bsp/drivers/ufs/Kconfig
```kconfig
# SPDX-License-Identifier: GPL-2.0-only
#
# ufs host controller drivers
#

menu "SUNXI UFS Drivers"
	depends on AW_BSP

config SCSI_UFS_SUNXI
	tristate "Allwinner A733 UFS support"
	depends on SCSI_UFSHCD_PLATFORM
	depends on ARCH_SUNXI
	select NVMEM
	help
	  Enable the platform glue for the UFS host controller found in the
	  Allwinner A733 SoC. The driver controls the host clocks and resets,
	  initializes the integrated M-PHY, and loads board calibration data
	  from the SoC NVMEM provider. The controller is integrated into the
	  A733 and uses the standard UFS host controller core.

	  Say Y for systems that boot from UFS.

endmenu
```

## drivers/staging/rtk-btsdio/Kconfig
```kconfig
# SPDX-License-Identifier: GPL-2.0
config RTK_BTSDIO
	tristate "Realtek RTL8733BS SDIO Bluetooth support"
	depends on BT && MMC && m && RTL8733BS
	select FW_LOADER
	help
	  Bluetooth HCI transport for the Realtek RTL8733BS combo radio,
	  using the SDIO interface exported by the rtl8733bs WiFi driver
	  (SDIO ID 0x024c:0xb73a).  The Bluetooth firmware is loaded from
	  userspace through the Bluetooth subsystem.

	  To compile this driver as a module, choose M here: the module
	  will be called btrtksdio.
```

## drivers/staging/rtl8733bs/Kconfig
```kconfig
# SPDX-License-Identifier: GPL-2.0
config RTL8733BS
	tristate "Realtek RTL8733BS SDIO WiFi support"
	depends on WLAN && CFG80211 && MMC && m
	select FW_LOADER
	help
	  Driver for the Realtek RTL8733BS 802.11ac SDIO wireless
	  network adapter.  This is the SDIO variant of the RTL8733B
	  (SDIO IDs 0x024c:0xb733 and 0x024c:0xb73a); the USB variant
	  RTL8733BU is not supported by this driver.

	  To compile this driver as a module, choose M here: the module
	  will be called rtl8733bs.
```
