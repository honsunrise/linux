// SPDX-License-Identifier: (GPL-2.0 OR MIT)
/*
 * Sipeed LicheeRV Nano B (SG2002).
 *
 * The B variant is the base board: no Ethernet and no WiFi/BT
 * (Sipeed wiki, "Version Comparison").  It therefore includes neither
 * sg2002-licheerv-nano-eth.dtsi nor sg2002-licheerv-nano-wifi.dtsi; in
 * particular SDIO1 stays disabled, the AIC8800 is not populated.
 */

/dts-v1/;

#include "sg2002-licheerv-nano.dtsi"

/ {
	model = "Sipeed LicheeRV Nano B";
	compatible = "sipeed,licheerv-nano-b", "sipeed,licheerv-nano", "sophgo,sg2002";
};
